## Kconfig
```kconfig
#
# For a description of the syntax of this configuration file,
# see Documentation/kbuild/kconfig-language.txt.
#
mainmenu "Kconfig Configuration"

config TOP_TEST
	bool "top test"
	help
	  top test

source test/Kconfig
# source "arch/$SRCARCH/Kconfig"
```

## test/Kconfig
```kconfig
config TEST
	bool "test module"
	help
	  test module

config HELLOWORLD
	bool "hello world"
	help
	  the demo of helloworld

config CPP
	bool "test cpp"
	help
	  test cpp

source "test/sub/Kconfig"
source "test/sub1/Kconfig"
```

## test/sub/Kconfig
```kconfig
config SUB
	bool "sub"
	help
	  sub of test

config THREAD
	bool "thread"
	help
	  test shared lib

config SHARED
	bool "shared"
	help
	  test shared lib
```
